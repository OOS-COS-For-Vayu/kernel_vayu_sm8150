## coretech/Kconfig
```kconfig
config HOUSTON
	default n
	bool "to collect system-wide and pmu data"
	help
	 Realtime temperature monitor
config CONTROL_CENTER
	default n
	bool "control center"
	help
	 A framework to adjust system resource such as perfd, but easy to extend
	 the scope of use. Support priority control between different request and
	 QoS for keep adjusting for a specific period. Besides resource controlling,
	 it also provide a decision model for helping governor to make decision.
```

## drivers/oplus/Kconfig
```kconfig
# SPDX-License-Identifier: GPL-2.0-only

config OPLUS_FEATURES
	bool "Enable OPlus Specific Drivers and Features"
	default n
	help
	  Master switch for OPlus drivers (Frame Boost, HANS, OSI,
	  Process Reclaim, Midas, etc.).

if OPLUS_FEATURES
source "drivers/oplus/hans/Kconfig"
source "drivers/oplus/frame_boost/Kconfig"
source "drivers/oplus/midas/Kconfig"
source "drivers/oplus/vnet/Kconfig"
source "drivers/oplus/devinfo/Kconfig"
source "drivers/oplus/project/Kconfig"
source "drivers/oplus/process_reclaim/Kconfig"
source "drivers/oplus/force_shutdown/Kconfig"
source "drivers/oplus/storage/Kconfig"
source "drivers/oplus/bootprof/Kconfig"
source "drivers/oplus/dump_reason/Kconfig"
source "drivers/oplus/sched_info/Kconfig"
source "drivers/oplus/binder_strategy/Kconfig"
source "drivers/oplus/shutdown_detect/Kconfig"
endif
```

## drivers/oplus/binder_strategy/Kconfig
```kconfig
# SPDX-License-Identifier: GPL-2.0-only
config OPLUS_BINDER_STRATEGY
	bool "OPLUS Binder Strategy"
	default y
	help
	  Customized binder optimization strategy.
```

## drivers/oplus/bootprof/Kconfig
```kconfig
# SPDX-License-Identifier: GPL-2.0-only
config OPLUS_BOOTPROF
	bool "OPLUS Bootprof"
	default y
	help
	  Record and display boot time profiling info in procfs.
```

## drivers/oplus/devinfo/Kconfig
```kconfig
# SPDX-License-Identifier: GPL-2.0-only
config OPLUS_DEVICE_IFNO
	bool "config oplus devinfo software"
	default y
	help
	  define this config to compile devinfo.c for device register

config OPLUS_DEVICE_INFO_MTK_PLATFORM
	bool "OPLUS platform device info module used"
	default n
	help
	  Say Y here if you have mtk-platform.

config OPLUS_POGOPIN_FUNCTION
	bool "OPLUS pogopin keyboard module used"
	default n
	help
	  Say Y here if you have pogopin keyboard.
```

## drivers/oplus/dump_reason/Kconfig
```kconfig
# SPDX-License-Identifier: GPL-2.0-only
config OPLUS_FEATURE_DUMP_REASON
	bool "OPLUS Dump Reason"
	default y
	help
	  Record panic / dump reason into smem and device info.
```

## drivers/oplus/force_shutdown/Kconfig
```kconfig
# SPDX-License-Identifier: GPL-2.0-only
# Copyright (C) 2018-2021 Oplus. All rights reserved.
config OPLUS_FEATURE_FORCE_SHUTDOWN
	bool "force shutdown"
	default n
	help
	  define this config to enable force shutdown feature.
```

## drivers/oplus/frame_boost/Kconfig
```kconfig
# SPDX-License-Identifier: GPL-2.0-only

config OPLUS_FEATURE_FRAME_BOOST
	bool "Oplus Frame Boost support"
	default y
	help
	  Oplus Frame Boost dynamically manages CPU frequency and scheduling
	  for render threads and critical UI tasks.

config OPLUS_FEATURE_MULTI_FBG
	bool "Multi Render Thread Group Frame Boost"
	depends on OPLUS_FEATURE_FRAME_BOOST
	default y
	help
	  Support multiple frame boost groups (e.g. UI, render, composition).
```

## drivers/oplus/hans/Kconfig
```kconfig
# SPDX-License-Identifier: GPL-2.0-only

config OPLUS_FEATURE_HANS
	bool "HANS kernel and HANS native communication channel"
	default y
	help
	  Key events (signal/network package/binder) report to HANS native.
```

## drivers/oplus/process_reclaim/Kconfig
```kconfig
# SPDX-License-Identifier: GPL-2.0-only
# Copyright (C) 2018-2020 Oplus. All rights reserved.
config PROCESS_RECLAIM_ENHANCE
	bool "OPLUS Process Reclaim Enhancement"
	default n
	help
	  Enable OPLUS Process Reclaim Enhancement driver.
```

## drivers/oplus/project/Kconfig
```kconfig
# SPDX-License-Identifier: GPL-2.0-only
# Copyright (C) 2018-2020 Oplus. All rights reserved.
config OPLUS_FEATURE_OPROJECT
	bool "config oplus project info for kernel"
	default n
	help
	  define this config to define oplus project

config OPLUS_SYSTEM_KERNEL_QCOM
	bool "OPLUS system kernel for Qualcomm"
	default y
	help
	  Enable OPLUS system kernel features on Qualcomm platforms.
```

## drivers/oplus/sched_info/Kconfig
```kconfig
# SPDX-License-Identifier: GPL-2.0-only
config OPLUS_FEATURE_CPU_JANKINFO
	bool "OPLUS CPU Jank Info and Healthinfo"
	default y
	help
	  Record CPU Jank Information, Sched Info, and Health Info.
```

## drivers/oplus/storage/Kconfig
```kconfig
# SPDX-License-Identifier: GPL-2.0-only

config OPLUS_FEATURE_STORAGE_IO_METRICS
	bool "OPLUS Storage IO Metrics"
	default y
	help
	  Collect various metrics on the IO path.

source "drivers/oplus/storage/common/fmonitor/Kconfig"
source "drivers/oplus/storage/storage_feature_in_module/common/storage_log/Kconfig"
```

## drivers/oplus/vnet/Kconfig
```kconfig
# SPDX-License-Identifier: GPL-2.0-only
# Copyright (C) 2020-2022 Oplus. All rights reserved.

config OPLUS_FEATURE_VIRTUAL_NET
	bool "Add for virtual net device for datashare"
	default y
	help
	  Add for virtual net device for datashare
```
